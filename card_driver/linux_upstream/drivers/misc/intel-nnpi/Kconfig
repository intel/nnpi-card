## card_driver/linux_upstream/drivers/misc/intel-nnpi/Kconfig
```kconfig
#
# Copyright (C) 2019-2020 Intel Corporation
#
# SPDX-License-Identifier: GPL-2.0-or-later
#

config INTEL_NNPI
	tristate "Intel(R) NNP-I (AI accelerator for inference) device driver"
	depends on PCI
	select DMA_SHARED_BUFFER
	help
	  Device driver for Intel NNP-I PCIe accelerator card for AI inference.

	  If unsure, say N.

	  To compile this driver as a module, choose M here. The module
	  will be called intel_nnpidrv.
```

## nnpi_os_buildroot/configs/NNPI_x86_64_efi_defconfig
```kconfig
# Architecture
BR2_x86_64=y

# Toolchain, required for eudev (to autoload drivers)
BR2_TOOLCHAIN_BUILDROOT_WCHAR=y

#GCC optimization level
BR2_OPTIMIZE_2=y

#
# Toolchain
#
BR2_TOOLCHAIN=y
BR2_TOOLCHAIN_USES_GLIBC=y
BR2_TOOLCHAIN_BUILDROOT=y

#
# Toolchain Buildroot Options
#
BR2_TOOLCHAIN_BUILDROOT_VENDOR="buildroot"
BR2_TOOLCHAIN_BUILDROOT_GLIBC=y
BR2_TOOLCHAIN_BUILDROOT_LIBC="glibc"
BR2_TOOLCHAIN_BUILDROOT_CXX=y

# System
BR2_TARGET_GENERIC_HOSTNAME="Intel_NNPI[Release]"
BR2_TARGET_GENERIC_ISSUE="Welcome to NNPI OS - V0.0.85 2019_06_26"
BR2_ROOTFS_OVERLAY="board/sph/rootfs-overlay"


#NNPI - to be determined until Beta
BR2_TARGET_GENERIC_GETTY=y
BR2_TARGET_GENERIC_GETTY_PORT="ttyS0"
BR2_TARGET_GENERIC_GETTY_BAUDRATE_KEEP=y
BR2_TARGET_GENERIC_GETTY_BAUDRATE="0"
BR2_TARGET_GENERIC_GETTY_TERM="vt100"
BR2_TARGET_GENERIC_GETTY_OPTIONS=""
#end of #NNPI - to be determined until Beta

BR2_TARGET_GENERIC_REMOUNT_ROOTFS_RW=y
BR2_ROOTFS_DEVICE_CREATION_DYNAMIC_EUDEV=y

#target package
BR2_PACKAGE_GLIBC=y
# libZ.so - required by Ice drv
BR2_PACKAGE_LIBZIP=y
BR2_PACKAGE_ZLIB=y
BR2_PACKAGE_LIBZLIB=y
BR2_PACKAGE_HAS_ZLIB=y
BR2_PACKAGE_PROVIDES_ZLIB="libzlib"

# Required tools to create bootable media
BR2_PACKAGE_HOST_DOSFSTOOLS=y
BR2_PACKAGE_HOST_GENIMAGE=y
BR2_PACKAGE_HOST_MTOOLS=y

# Bootloader
# BR2_TARGET_GRUB2=y
# BR2_TARGET_GRUB2_X86_64_EFI=y
# BR2_TARGET_GRUB2_BUILTIN_MODULES="boot linux ext2 squash4 part_msdos part_gpt normal efi_gop fat iso9660 configfile loopback chain efifwsetup efi_uga ls search search_label search_fs_uuid search_fs_file gfxterm gfxterm_background gfxterm_menu test all_video loadenv exfat ntfs btrfs hfsplus udf"
# BR2_TARGET_GRUB2_BUILTIN_CONFIG="board/sph/grub_config_release.cfg"

# Filesystem / image
# 	Added INITRAMFS as the ROOTFS
BR2_TARGET_ROOTFS_INITRAMFS=y
BR2_ROOTFS_POST_IMAGE_SCRIPT="board/sph/post-image.sh support/scripts/genimage.sh"
# Linux headers same as kernel, a 5.1 series
BR2_PACKAGE_HOST_LINUX_HEADERS_CUSTOM_5_1=y

# Kernel
BR2_LINUX_KERNEL=y
BR2_LINUX_KERNEL_CUSTOM_VERSION=y
BR2_LINUX_KERNEL_CUSTOM_VERSION_VALUE="5.1"
BR2_LINUX_KERNEL_VERSION="5.1"
BR2_LINUX_KERNEL_USE_CUSTOM_CONFIG=y
BR2_LINUX_KERNEL_CUSTOM_CONFIG_FILE="board/sph/linux-nnpi.config"
BR2_LINUX_KERNEL_PATCH="board/sph/kernel-patches"
BR2_LINUX_KERNEL_INSTALL_TARGET=y

# Firmware
BR2_PACKAGE_LINUX_FIRMWARE=y
BR2_PACKAGE_LINUX_FIRMWARE_RTL_8169=y

# Packages
# Use connman so that networking setup is simpler, via connmanctl tool
BR2_PACKAGE_CONNMAN=n
BR2_PACKAGE_CONNMAN_CLIENT=n
BR2_PACKAGE_CONNMAN_WIFI=n


### NNPI- for sysklogd 
BR2_PACKAGE_BUSYBOX_SHOW_OTHERS=y
BR2_PACKAGE_SYSKLOGD=y


BR2_ROOTFS_POST_BUILD_SCRIPT="board/sph/post_build.sh"
BR2_ROOTFS_POST_SCRIPT_ARGS="-c board/sph/genimage-efi-nnpi.cfg Release"
BR2_ROOTFS_POST_FAKEROOT_SCRIPT=""
BR2_PACKAGE_UTIL_LINUX_LSBLK=y

#BR2_x86_corei7=y
BR2_GCC_TARGET_ARCH="core-avx2"
BR2_X86_CPU_HAS_MMX=y
BR2_X86_CPU_HAS_SSE=y
BR2_X86_CPU_HAS_SSE2=y
BR2_X86_CPU_HAS_SSE3=y
BR2_X86_CPU_HAS_SSSE3=y
BR2_X86_CPU_HAS_SSE4=y
BR2_X86_CPU_HAS_SSE42=y
BR2_X86_CPU_HAS_AVX=y
BR2_X86_CPU_HAS_AVX2=y
BR2_x86_core_avx2=y
```

## nnpi_os_buildroot/configs/NNPI_x86_64_efi_release_defconfig
```kconfig
# Architecture
BR2_x86_64=y

# Toolchain, required for eudev (to autoload drivers)
BR2_TOOLCHAIN_BUILDROOT_WCHAR=y
BR2_x86_corei7=y

#GCC optimization level
BR2_OPTIMIZE_2=y

#
# Toolchain
BR2_TOOLCHAIN=y
BR2_TOOLCHAIN_USES_GLIBC=y
BR2_TOOLCHAIN_BUILDROOT=y

#
# Toolchain Buildroot Options
BR2_TOOLCHAIN_BUILDROOT_VENDOR="buildroot"
BR2_TOOLCHAIN_BUILDROOT_GLIBC=y
BR2_TOOLCHAIN_BUILDROOT_LIBC="glibc"
BR2_TOOLCHAIN_BUILDROOT_CXX=y

# System
BR2_TARGET_GENERIC_HOSTNAME="Intel_NNPI[Release]"
BR2_TARGET_GENERIC_ISSUE="Welcome to NNPI OS - V0.0.69 2019_05_01"
BR2_ROOTFS_OVERLAY="board/sph/rootfs-overlay"


BR2_TARGET_GENERIC_GETTY=y
BR2_TARGET_GENERIC_GETTY_PORT="ttyS0"
BR2_TARGET_GENERIC_GETTY_BAUDRATE_KEEP=y
BR2_TARGET_GENERIC_GETTY_BAUDRATE="0"
BR2_TARGET_GENERIC_GETTY_TERM="vt100"
BR2_TARGET_GENERIC_GETTY_OPTIONS=""
BR2_TARGET_GENERIC_REMOUNT_ROOTFS_RW=y
BR2_ROOTFS_DEVICE_CREATION_DYNAMIC_EUDEV=y


#target package
BR2_PACKAGE_GLIBC=y
BR2_PACKAGE_LIBZIP=y
BR2_PACKAGE_ZLIB=y
BR2_PACKAGE_LIBZLIB=y
BR2_PACKAGE_HAS_ZLIB=y
BR2_PACKAGE_PROVIDES_ZLIB="libzlib"


# Required tools to create bootable media
BR2_PACKAGE_HOST_DOSFSTOOLS=y
BR2_PACKAGE_HOST_GENIMAGE=y
BR2_PACKAGE_HOST_MTOOLS=y

# Bootloader
BR2_TARGET_GRUB2=y
BR2_TARGET_GRUB2_X86_64_EFI=y
BR2_TARGET_GRUB2_BUILTIN_MODULES="boot linux ext2 squash4 part_msdos part_gpt normal efi_gop fat iso9660 configfile loopback chain efifwsetup efi_uga ls search search_label search_fs_uuid search_fs_file gfxterm gfxterm_background gfxterm_menu test all_video loadenv exfat ntfs btrfs hfsplus udf"
BR2_TARGET_GRUB2_BUILTIN_CONFIG="board/sph/grub_config_release.cfg"

# Filesystem / image
# 	Added INITRAMFS as the ROOTFS
BR2_TARGET_ROOTFS_INITRAMFS=y

BR2_ROOTFS_POST_IMAGE_SCRIPT="board/sph/post-image.sh support/scripts/genimage.sh"

# Linux headers same as kernel, a 4.15 series
BR2_PACKAGE_HOST_LINUX_HEADERS_CUSTOM_4_15=y

# Kernel
BR2_LINUX_KERNEL=y
BR2_LINUX_KERNEL_CUSTOM_VERSION=y
BR2_LINUX_KERNEL_CUSTOM_VERSION_VALUE="4.15.9"
BR2_LINUX_KERNEL_USE_CUSTOM_CONFIG=y
BR2_LINUX_KERNEL_CUSTOM_CONFIG_FILE="board/sph/linux-release.config"
BR2_LINUX_KERNEL_PATCH="board/sph/kernel-patches"
BR2_LINUX_KERNEL_INSTALL_TARGET=y

# Firmware
BR2_PACKAGE_LINUX_FIRMWARE=y
BR2_PACKAGE_LINUX_FIRMWARE_RTL_8169=y

# Packages
#
# Use connman so that networking setup is simpler, via connmanctl tool
BR2_PACKAGE_CONNMAN=n
BR2_PACKAGE_CONNMAN_CLIENT=n
BR2_PACKAGE_CONNMAN_WIFI=n


BR2_PACKAGE_BUSYBOX_SHOW_OTHERS=n
#BR2_PACKAGE_RSYSLOG=y
BR2_PACKAGE_OPENSSL=y
BR2_PACKAGE_E2FSPROGS=y
BR2_PACKAGE_E2FSPROGS_DEBUGFS=y
BR2_PACKAGE_BASH=y 
BR2_SYSTEM_BIN_SH_BASH=y
BR2_PACKAGE_BUSYBOX_SHOW_OTHERS=y


BR2_ROOTFS_POST_BUILD_SCRIPT="board/sph/post_build.sh"
BR2_ROOTFS_POST_SCRIPT_ARGS="-c board/sph/genimage-efi.cfg Release"
BR2_ROOTFS_POST_FAKEROOT_SCRIPT=""
BR2_PACKAGE_UTIL_LINUX_LSBLK=y
BR2_PACKAGE_LIBARCHIVE=y
```

## nnpi_os_buildroot/configs/SPH_x86_64_efi_nnpi_defconfig
```kconfig
BR2_x86_64=y
BR2_x86_core_avx2=y
BR2_OPTIMIZE_3=y
# BR2_COMPILER_PARANOID_UNSAFE_PATH is not set
BR2_TOOLCHAIN_BUILDROOT_GLIBC=y
BR2_GCC_VERSION_7_X=y
BR2_TOOLCHAIN_BUILDROOT_CXX=y
BR2_TARGET_GENERIC_HOSTNAME="Intel_NNPI[Release]"
BR2_TARGET_GENERIC_ISSUE="Welcome to NNPI OS - V0.3.05"
BR2_ROOTFS_DEVICE_CREATION_DYNAMIC_EUDEV=y
BR2_TARGET_GENERIC_ROOT_PASSWD="sph"
BR2_TARGET_GENERIC_GETTY_PORT="ttyS0"
BR2_TARGET_TZ_INFO=y
BR2_TARGET_LOCALTIME="America/Los_Angeles"
BR2_ROOTFS_OVERLAY="board/sph/rootfs-overlay"
BR2_ROOTFS_POST_BUILD_SCRIPT="board/sph/post_build.sh"
BR2_ROOTFS_POST_IMAGE_SCRIPT="board/sph/post-image.sh support/scripts/genimage.sh"
BR2_ROOTFS_POST_SCRIPT_ARGS="-c board/sph/genimage-efi-nnpi.cfg Release"
BR2_LINUX_KERNEL=y
BR2_LINUX_KERNEL_CUSTOM_VERSION=y
BR2_LINUX_KERNEL_CUSTOM_VERSION_VALUE="5.4"
BR2_LINUX_KERNEL_PATCH="board/sph/kernel-patches"
BR2_LINUX_KERNEL_USE_CUSTOM_CONFIG=y
BR2_LINUX_KERNEL_CUSTOM_CONFIG_FILE="board/sph/linux-nnpi.config"
BR2_PACKAGE_BUSYBOX_SHOW_OTHERS=y
BR2_PACKAGE_LINUX_FIRMWARE=y
BR2_PACKAGE_LINUX_FIRMWARE_RTL_8169=y
BR2_PACKAGE_LIBZIP=y
BR2_PACKAGE_LIBSSH=y
BR2_PACKAGE_ELFUTILS=y
BR2_PACKAGE_ELFUTILS_PROGS=y
BR2_PACKAGE_OPENSSH=y
BR2_PACKAGE_SYSLOG_NG=y
BR2_TARGET_ROOTFS_INITRAMFS=y
BR2_PACKAGE_HOST_DOSFSTOOLS=y
BR2_PACKAGE_HOST_GENIMAGE=y
BR2_PACKAGE_HOST_MTOOLS=y
BR2_STRIP_strip=n
```

## nnpi_os_buildroot/package/SimicsAgent/Config.in
```kconfig
config BR2_PACKAGE_SimicsAgent
    bool "SimicsAgent"
    default y
    help
      Simics agent will allow coping files from to Simics and Host machine
```

## nnpi_os_buildroot/package/intel-nnpi/Config.in
```kconfig
source "package/intel-nnpi/blob/Config.in"
source "package/intel-nnpi/psw/Config.in"
source "package/intel-nnpi/ice_driver_kernel/Config.in"
source "package/intel-nnpi/ice_driver_user/Config.in"
source "package/intel-nnpi/runtime/Config.in"
```

## nnpi_os_buildroot/package/intel-nnpi/blob/Config.in
```kconfig
config BR2_PACKAGE_BLOB
        bool "intel_nnpi_blob"
        help

          http://www.intel.com
```

## nnpi_os_buildroot/package/intel-nnpi/ice_driver_kernel/Config.in
```kconfig
config BR2_PACKAGE_ICE_DRIVER_KERNEL
        bool "ice_driver_kernel_package"
        depends on BR2_PACKAGE_PSW
	depends on BR2_LINUX_KERNEL
        help
	  ICE driver kernel.

          http://www.intel.com
```

## nnpi_os_buildroot/package/intel-nnpi/ice_driver_user/Config.in
```kconfig
config BR2_PACKAGE_ICE_DRIVER_USER
        bool "ice_driver_user_package"
        depends on BR2_PACKAGE_ICE_DRIVER_KERNEL
        help
	  ICE driver user.

          http://www.intel.com
```

## nnpi_os_buildroot/package/intel-nnpi/kasan/Config.in
```kconfig
config BR2_PACKAGE_KASAN
        bool "intel_nnapi_kasan_package"
    depends on BR2_LINUX_KERNEL
        help
      the purpose of this package under intel-nnpi packages 
      is to copy the kasan lib's from the toolchain to the device filesystem

          http://www.intel.com
```

## nnpi_os_buildroot/package/intel-nnpi/manufTool/Config.in
```kconfig
config BR2_PACKAGE_MANUFTOOL
        bool "intel_nnpi_manufTool"
	depends on BR2_PACKAGE_PSW
        help

          http://www.intel.com
```

## nnpi_os_buildroot/package/intel-nnpi/psw/Config.in
```kconfig
config BR2_PACKAGE_PSW
        bool "intel_nnpi_psw"
        depends on BR2_LINUX_KERNEL
	depends on BR2_PACKAGE_BLOB

        help
	  Intel NNPI Platform Software package.
	  PSW needs a Linux kernel to be built

          http://www.intel.com
```

## nnpi_os_buildroot/package/intel-nnpi/runtime/Config.in
```kconfig
config BR2_PACKAGE_RUNTIME
        bool "intel_nnpi_runtime"
	depends on BR2_PACKAGE_ICE_DRIVER_USER
        help

          http://www.intel.com
```

## nnpi_os_buildroot/package/pci_debug/Config.in
```kconfig
config BR2_PACKAGE_PCI_DEBUG
	bool "pci_debug"
	default n
	select BR2_PACKAGE_READLINE
	select BR2_PACKAGE_NCURSES
	help
	  this package allows writing/reading from PCI device registers
	  using their BARs

	  http://www.armadeus.org/wiki/index.php?title=Pci_debug
          #Buildroot_configuration
```
